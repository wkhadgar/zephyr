## west.yml
```yaml
# The west manifest file for upstream Zephyr.
#
# The per-installation west configuration file, .west/config, sets the
# path to the project containing this file in the [manifest] section's
# "path" variable.
#
# You are free to create your own manifest files and put them in any
# repository you want, to create your own custom Zephyr installations.
# For example, you could create a manifest file in your own out of
# tree application directory, which would pull this zephyr repository
# in as an ordinary project.
#
# You can pass your manifest repositories to west init when creating a
# new Zephyr installation. See the west documentation for more
# information.

manifest:
  defaults:
    remote: upstream

  remotes:
    - name: upstream
      url-base: https://github.com/zephyrproject-rtos

  group-filter: [ -optional ]

  projects:
    - name: cmsis
      revision: d1b8b20b6278615b00e136374540eb1c00dcabe7
      path: modules/hal/cmsis
      groups:
        - hal
    - name: cmsis-dsp
      revision: d80a49b2bb186317dc1db4ac88da49c0ab77e6e7
      path: modules/lib/cmsis-dsp
    - name: cmsis-nn
      revision: e9328d612ea3ea7d0d210d3ac16ea8667c01abdd
      path: modules/lib/cmsis-nn
    - name: cmsis_6
      repo-path: CMSIS_6
      revision: 6dd50439a9b83398ff2ae1376eef0a2a0b95913b
      path: modules/hal/cmsis_6
      groups:
        - hal
    - name: edtt
      revision: b9ca3c7030518f07b7937dacf970d37a47865a76
      path: tools/edtt
      groups:
        - tools
    - name: fatfs
      revision: 16245c7c41d2b79e74984f49b5202551786b8a9b
      path: modules/fs/fatfs
      groups:
        - fs
    - name: hal_st
      revision: 9f81b4427e955885398805b7bca0da3a8cd9109c
      path: modules/hal/st
      groups:
        - hal
    - name: hal_stm32
      revision: 5cbc642b1a79d4f373b1587f8c3027f31bf0d30c
      path: modules/hal/stm32
      groups:
        - hal
    - name: picolibc
      path: modules/lib/picolibc
      revision: 560946f26db075c296beea5b39d99e6de43c9010
    - name: segger
      revision: cf56b1d9c80f81a26e2ac5727c9cf177116a4692
      path: modules/debug/segger
      groups:
        - debug

  self:
    path: zephyr
    west-commands: scripts/west-commands.yml
    import: submanifests
```
